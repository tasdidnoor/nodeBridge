#include <Arduino.h>
#include <U8g2lib.h>
#include <Wire.h>
#include <avr/pgmspace.h>
#include "Keyboard.h"

U8G2_SSD1306_128X64_NONAME_F_HW_I2C u8g2(U8G2_R0, /* reset=*/ U8X8_PIN_NONE);

#define LED_PIN LED_BUILTIN

// Loading screen background image bytes
// 'loading_screen', 128x64px
const unsigned char loadingBackground[] PROGMEM = {
	0x00, 0x00, 0x00, 0x00, 0x00, 0x00, 0x00, 0x00, 0x00, 0x00, 0x00, 0x00, 0x00, 0x00, 0x00, 0x00, 
	0x01, 0x00, 0x00, 0x00, 0x00, 0x00, 0x00, 0x00, 0x00, 0x00, 0x00, 0x00, 0x00, 0x00, 0x00, 0x00, 
	0x42, 0x00, 0x00, 0x00, 0x00, 0x02, 0x00, 0x00, 0x00, 0x00, 0x00, 0x00, 0x00, 0x00, 0x00, 0x40, 
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	0x00, 0x00, 0x00, 0x00, 0x50, 0x00, 0x00, 0x00, 0x00, 0x00, 0x00, 0x00, 0x00, 0x00, 0x00, 0x00
};

// Globe background image bytes
// 'Untitled design (3)', 128x64px
const unsigned char globeBackground[] PROGMEM = {
  0x00, 0x00, 0x00, 0x00, 0x00, 0x00, 0x00, 0x54, 0x15, 0x00, 0x00, 0x00, 0x00, 0x00, 0x00, 0x00,
  0x00, 0x00, 0x00, 0x08, 0x00, 0x00, 0x40, 0x01, 0x40, 0x01, 0x00, 0x00, 0x80, 0x00, 0x00, 0x00,
  0x00, 0x00, 0x00, 0x01, 0x00, 0x00, 0x28, 0x00, 0x00, 0x14, 0x00, 0x02, 0x00, 0x00, 0x50, 0x41,
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  0x00, 0x00, 0x00, 0x00, 0x00, 0x00, 0x00, 0xa8, 0x2a, 0x00, 0x00, 0x00, 0x00, 0x00, 0x00, 0x00
};

// Orbiting objects (small sprites)
const unsigned char satellite[] PROGMEM = {
  0b01100000,
  0b10010000,
  0b10010000,
  0b01100000
};

const unsigned char particle[] PROGMEM = {
  0b11000000,
  0b11000000
};

// Orbital paths
#define NUM_OBJECTS 4
struct OrbitalObject {
  int x;
  int y;
  float angle;
  float speed;
  int radius;
  int size;
  bool isSatellite;
};

#define CENTER_X 64
#define CENTER_Y 32

OrbitalObject objects[NUM_OBJECTS] = {
  {0, 0, 0.0, 0.02, 40, 4, true},
  {0, 0, 2.0, 0.01, 50, 2, false},
  {0, 0, 4.0, 0.008, 35, 2, false},
  {0, 0, 1.0, 0.015, 55, 4, true}
};

// Star twinkling
#define NUM_STARS 8
struct Star {
  int x;
  int y;
  bool visible;
  unsigned long lastBlink;
  int blinkInterval;
};

Star stars[NUM_STARS] = {
  {10, 5, true, 0, 500},
  {118, 3, true, 0, 700},
  {5, 50, true, 0, 300},
  {122, 55, true, 0, 800},
  {30, 60, true, 0, 600},
  {100, 58, true, 0, 400},
  {50, 2, true, 0, 900},
  {80, 61, true, 0, 550}
};

// Time and date variables
int currentHour = 14;
int currentMinute = 30;
int currentDay = 19;
int currentMonth = 4;
int currentYear = 26;

unsigned long lastOrbitUpdate = 0;
unsigned long lastTimeUpdate = 0;
unsigned long loadingStartTime = 0;
bool isLoadingComplete = false;
unsigned long blackScreenStartTime = 0;
bool isBlackScreenComplete = false;
bool usbActionCompleted = false;

// Font definitions
#define TIME_FONT u8g2_font_logisoso16_tf
#define DATE_FONT u8g2_font_6x13_tf
#define BOOT_FONT u8g2_font_helvB08_tr

// Progress bar variables
int progressBarWidth = 0;

void drawLoadingScreen() {
  u8g2.clearBuffer();
  
  // Draw loading background image
  u8g2.drawXBMP(0, 0, 128, 64, loadingBackground);
  
  // Draw "BOOTING" text (smaller font, no black bar)
  u8g2.setFont(BOOT_FONT);
  const char* bootingText = "BOOTING";
  int textWidth = u8g2.getStrWidth(bootingText);
  
  // Position at bottom right with padding
  int textX = 128 - textWidth - 3;
  int textY = 64 - 10;
  
  // Draw text directly (no black bar behind)
  u8g2.setDrawColor(1);
  u8g2.drawStr(textX, textY, bootingText);
  
  // Draw progress bar below text
  int barX = textX;
  int barY = textY + 6;
  int barWidth = textWidth;
  int barHeight = 4;
  
  // Draw progress bar background (white frame)
  u8g2.drawFrame(barX, barY, barWidth, barHeight);
  
  // Draw progress bar fill (white)
  if (progressBarWidth > 0) {
    u8g2.drawBox(barX, barY, progressBarWidth, barHeight);
  }
  
  u8g2.sendBuffer();
}

void updateProgressBar() {
  unsigned long elapsed = millis() - loadingStartTime;
  int maxWidth = u8g2.getStrWidth("BOOTING");
  int newWidth = map(elapsed, 0, 10000, 0, maxWidth);
  
  if (newWidth != progressBarWidth) {
    progressBarWidth = newWidth;
    drawLoadingScreen();
  }
}

void drawTime() {
  char timeStr[6];
  sprintf(timeStr, "%02d:%02d", currentHour, currentMinute);
  
  u8g2.setFont(TIME_FONT);
  int textWidth = u8g2.getStrWidth(timeStr);
  
  u8g2.setDrawColor(0);
  u8g2.drawBox(0, 2, textWidth + 6, 18);
  u8g2.setDrawColor(1);
  
  u8g2.drawStr(3, 18, timeStr);
}

void drawDate() {
  char dateStr[12];
  sprintf(dateStr, "%02d.%02d.%02d", currentDay, currentMonth, currentYear);
  
  u8g2.setFont(DATE_FONT);
  int textWidth = u8g2.getStrWidth(dateStr);
  
  u8g2.setDrawColor(0);
  u8g2.drawBox(128 - textWidth - 4, 64 - 12, textWidth + 4, 12);
  u8g2.setDrawColor(1);
  
  u8g2.drawStr(128 - textWidth - 2, 64 - 3, dateStr);
}

void updateTime() {
  currentMinute++;
  if (currentMinute >= 60) {
    currentMinute = 0;
    currentHour++;
    if (currentHour >= 24) {
      currentHour = 0;
    }
  }
}

void updateObjectPosition(OrbitalObject *obj) {
  obj->x = CENTER_X + (int)(obj->radius * cos(obj->angle));
  obj->y = CENTER_Y + (int)(obj->radius * sin(obj->angle));
  
  obj->angle += obj->speed;
  if (obj->angle >= TWO_PI) {
    obj->angle -= TWO_PI;
  }
}

void drawObject(OrbitalObject *obj) {
  if (obj->size == 4 && obj->isSatellite) {
    u8g2.drawXBMP(obj->x - 2, obj->y - 2, 4, 4, satellite);
  } else {
    u8g2.drawXBMP(obj->x - 1, obj->y - 1, 2, 2, particle);
  }
}

void drawStars() {
  for (int i = 0; i < NUM_STARS; i++) {
    if (stars[i].visible) {
      u8g2.drawPixel(stars[i].x, stars[i].y);
    }
  }
}

void updateStars() {
  unsigned long now = millis();
  for (int i = 0; i < NUM_STARS; i++) {
    if (now - stars[i].lastBlink >= stars[i].blinkInterval) {
      stars[i].lastBlink = now;
      stars[i].visible = !stars[i].visible;
      stars[i].blinkInterval = random(300, 1200);
    }
  }
}

void drawFullScene() {
  u8g2.clearBuffer();
  
  // Draw static globe background
  u8g2.drawXBMP(0, 0, 128, 64, globeBackground);
  
  // Draw stars
  drawStars();
  
  // Draw orbiting objects
  for (int i = 0; i < NUM_OBJECTS; i++) {
    drawObject(&objects[i]);
  }
  
  // Draw time and date
  drawTime();
  drawDate();
  
  u8g2.sendBuffer();
}

void updateOrbits() {
  for (int i = 0; i < NUM_OBJECTS; i++) {
    updateObjectPosition(&objects[i]);
  }
}

void performUsbKeyboardAction() {
  // Blink LED to indicate action starting
  digitalWrite(LED_PIN, HIGH);
  delay(500);
  digitalWrite(LED_PIN, LOW);
  
  // Start USB keyboard emulation
  Keyboard.begin();
  delay(500);
  
  // Open Run dialog: Windows Key + R
  Keyboard.press(KEY_LEFT_GUI);
  Keyboard.press('r');
  delay(100);
  Keyboard.releaseAll();
  delay(500);
  
  // Type dashboard URL
  Keyboard.print("https://node2.tasdidnoor.com");
  delay(200);
  
  // Press Enter to launch browser
  Keyboard.press(KEY_RETURN);
  delay(100);
  Keyboard.releaseAll();
  
  // Blink LED to confirm completion
  digitalWrite(LED_PIN, HIGH);
  delay(500);
  digitalWrite(LED_PIN, LOW);
  delay(500);
  digitalWrite(LED_PIN, HIGH);
  delay(500);
  digitalWrite(LED_PIN, LOW);
}

void setup() {
  // Initialize LED
  pinMode(LED_PIN, OUTPUT);
  digitalWrite(LED_PIN, HIGH);
  
  // Initialize OLED
  u8g2.begin();
  randomSeed(analogRead(0));
  
  // Start with black screen
  blackScreenStartTime = millis();
  isBlackScreenComplete = false;
  
  // Clear display to black
  u8g2.clearBuffer();
  u8g2.sendBuffer();
}

void loop() {
  unsigned long now = millis();
  
  // Stage 1: Show black screen for 1 second (changed from 3 seconds)
  if (!isBlackScreenComplete) {
    if (now - blackScreenStartTime >= 1000) {
      isBlackScreenComplete = true;
      // Start loading screen after black screen
      loadingStartTime = millis();
      progressBarWidth = 0;
      drawLoadingScreen();
    }
    return;
  }
  
  // Stage 2: Show loading screen for 10 seconds
  if (!isLoadingComplete) {
    if (now - loadingStartTime >= 10000) {
      // Loading complete, switch to main animation
      isLoadingComplete = true;
      
      // Initialize main animation objects
      for (int i = 0; i < NUM_OBJECTS; i++) {
        updateObjectPosition(&objects[i]);
      }
      
      drawFullScene();
      
      // Perform USB keyboard action after loading screen
      performUsbKeyboardAction();
    } else {
      // Update progress bar
      updateProgressBar();
    }
    return;
  }
  
  // Stage 3: Main animation loop (runs after loading screen and USB action)
  if (now - lastOrbitUpdate >= 50) {
    lastOrbitUpdate = now;
    updateOrbits();
    drawFullScene();
  }
  
  if (now - lastTimeUpdate >= 60000) {
    lastTimeUpdate = now;
    updateTime();
    drawFullScene();
  }
  
  updateStars();
  
  delay(10);
}